## meta-orchontainerstrator/conf/layer.conf
```bitbake
BBPATH .= ":${LAYERDIR}"

BBFILES += "${LAYERDIR}/recipes-*/*/*.bb \
            ${LAYERDIR}/recipes-*/*/*.bbappend"

BBFILE_COLLECTIONS += "orchontainerstrator"
BBFILE_PATTERN_orchontainerstrator = "^${LAYERDIR}/"
BBFILE_PRIORITY_orchontainerstrator = "10"

LAYERDEPENDS_orchontainerstrator = "core mender mender-commercial mender-extended virtualization-layer"
LAYERSERIES_COMPAT_orchontainerstrator = "wrynose"
```
